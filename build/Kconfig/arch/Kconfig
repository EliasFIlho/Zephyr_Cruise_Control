## build/Kconfig/arch/Kconfig
```kconfig
# Load Zephyr Arch Kconfig descriptions.
osource "/home/elias/zephyrproject/zephyr/arch/x86/Kconfig"
osource "/home/elias/zephyrproject/zephyr/arch/xtensa/Kconfig"
osource "/home/elias/zephyrproject/zephyr/arch/sparc/Kconfig"
osource "/home/elias/zephyrproject/zephyr/arch/riscv/Kconfig"
osource "/home/elias/zephyrproject/zephyr/arch/posix/Kconfig"
osource "/home/elias/zephyrproject/zephyr/arch/nios2/Kconfig"
osource "/home/elias/zephyrproject/zephyr/arch/mips/Kconfig"
osource "/home/elias/zephyrproject/zephyr/arch/arm64/Kconfig"
osource "/home/elias/zephyrproject/zephyr/arch/arm/Kconfig"
osource "/home/elias/zephyrproject/zephyr/arch/arc/Kconfig"
```

## build/Kconfig/boards/Kconfig
```kconfig
# Load Zephyr board Kconfig descriptions.
osource "/home/elias/zephyrproject/zephyr/boards/espressif/esp32_devkitc_wroom/Kconfig"
```

## build/Kconfig/boards/Kconfig.defconfig
```kconfig
# Load Zephyr board defconfig descriptions.
osource "/home/elias/zephyrproject/zephyr/boards/espressif/esp32_devkitc_wroom/Kconfig.defconfig"
```

## build/Kconfig/boards/Kconfig.esp32_devkitc_wroom
```kconfig
# Load board Kconfig descriptions.
osource "/home/elias/zephyrproject/zephyr/boards/espressif/esp32_devkitc_wroom/Kconfig.esp32_devkitc_wroom"
```
